## CMakeLists.txt
```
# SPDX-License-Identifier: Apache-2.0

cmake_minimum_required(VERSION 3.20.0)

find_package(Zephyr REQUIRED HINTS $ENV{ZEPHYR_BASE})
project(narada_light)

target_sources(app PRIVATE src/light.c)
```

## prj.conf
```kconfig
# Logging
CONFIG_LOG=y
CONFIG_LOG_MAX_LEVEL=1
CONFIG_LOG_MODE_MINIMAL=n
CONFIG_BOOT_BANNER=y
CONFIG_LOG_BACKEND_UART=y

# Kernel options
CONFIG_MAIN_STACK_SIZE=2560
CONFIG_INIT_STACKS=y

CONFIG_SYSTEM_WORKQUEUE_STACK_SIZE=3072

# Network
CONFIG_NETWORKING=y
CONFIG_NET_CONFIG_SETTINGS=y

# Libraries
CONFIG_JSON_LIBRARY=y
CONFIG_COAP=y
CONFIG_COAP_CLIENT=y
CONFIG_COAP_SERVER=y

CONFIG_EVENTS=y
CONFIG_SMF=y

# Narada
CONFIG_NARADA=y
```

## boards/native_sim.conf
```kconfig
CONFIG_GPIO=y

CONFIG_SHELL=y
CONFIG_NET_SHELL=y
CONFIG_NET_IPV4=y
CONFIG_NET_DHCPV4=y

CONFIG_COAP=y
CONFIG_COAP_SERVER=y

CONFIG_NET_L2_ETHERNET=y
CONFIG_NATIVE_SIM_SLOWDOWN_TO_REAL_TIME=y
CONFIG_UART_NATIVE_PTY_0_ON_STDINOUT=y
CONFIG_PICOLIBC=y

# Enable only one protocol, if you enable both sources
# won't compile.
# IPv6 Support
CONFIG_NET_IPV6=y
CONFIG_NET_CONFIG_NEED_IPV6=y
CONFIG_NET_CONFIG_MY_IPV6_ADDR="2001:db8::1"
CONFIG_NET_IF_MCAST_IPV6_ADDR_COUNT=5

#IPv4 Support
CONFIG_NET_IPV4=n
CONFIG_NET_CONFIG_NEED_IPV4=n
CONFIG_NET_CONFIG_MY_IPV4_ADDR="192.0.2.1"
```

## boards/cc1352p7_lp.overlay
```dts
/ {
	switch1 {
		compatible = "narada,switch-gpio";

		gpios = <&gpio0 7 GPIO_ACTIVE_HIGH>;
	};

	switch2 {
		compatible = "narada,switch-gpio";

		gpios = <&gpio0 6 GPIO_ACTIVE_HIGH>;
	};

};
```

## boards/native_sim.overlay
```dts
/ {
	switch1 {
		compatible = "narada,switch-gpio";

		gpios = <&gpio0 1 GPIO_ACTIVE_HIGH>;
	};

	switch2 {
		compatible = "narada,switch-gpio";

		gpios = <&gpio0 2 GPIO_ACTIVE_HIGH>;
	};

};
```

## boards/nucleo_f429zi.overlay
```dts
/ {
	narada_device: narada_device {
		compatible = "gordios,narada";
		device-id = "Narada_light";
		heartbeat-interval = <60>;

		light1 {
			device_type = "light";
			compatible = "narada,light-gpio";
			gpios = <&gpiob 7 GPIO_ACTIVE_HIGH>;
		};
	};

	discovery: discovery {
		compatible = "narada,discovery";
		device = <&narada_device>;
	};
};
```

## src/light.c
```c
#include <narada/service.h>

int main(void)
{
	/* TODO: Move this to a dedicated thread */
	narada_run();

	return 0;
}
```
