## boards/gordios/zeus/board.yml
```yaml
board:
  name: zeus
  full_name: Zeus mother board from Pandora project
  vendor: gordios
  socs:
  - name: cc1352p7
```

## drivers/gpio/Kconfig
```kconfig
config GPIO_FAKE
    bool "Fake GPIO controller"
    depends on DT_HAS_ZEPHYR_GPIO_FAKE_ENABLED
```

## drivers/light/Kconfig
```kconfig
config LIGHT
	bool "Light driver"

if LIGHT

config LIGHT_SHELL
	bool "Light shell"
	depends on SHELL

config LIGHT_GPIO
	bool "Light GPIO"
	default y
	depends on DT_HAS_PANDORA_LIGHT_GPIO_ENABLED

config LIGHT_RGBCT
	bool "Light RGB-CT"
	default y
	depends on DT_HAS_PANDORA_LIGHT_RGBCT_ENABLED

module = LIGHT
module-str = light
source "subsys/logging/Kconfig.template.log_config"

endif
```

## drivers/sensor/Kconfig
```kconfig
# Copyright (c) 2025 Alexandre Bailon
# SPDX-License-Identifier: Apache-2.0

menuconfig SENSOR_SIMULATOR
	bool "Sensor value simulator driver"
	default n
	depends on SENSOR
	help
	  Enable sensor simulator for testing.

if SENSOR_SIMULATOR

config SENSOR_SIM_TRIGGER
	bool "Sensor simulator trigger support"
	default n
	help
	  Enable trigger mode for sensor simulator.
	  
config SENSOR_SIM_TRIGGER_INTERVAL
	int "Simulated trigger interval in milliseconds"
	depends on SENSOR_SIM_TRIGGER
	default 1000
	help
	  Specify the interval between simulated sensor trigger events
	  in milliseconds.

module = SENSOR_SIMULATOR
module-str = sensor_simulator
source "subsys/logging/Kconfig.template.log_config"

endif # SENSOR_SIMULATOR
```

## dts/bindings/discovery.yaml
```yaml
# SPDX-License-Identifier: Apache-2.0

description: Hermes CoAP Discovery Client Configuration

compatible: "pandora,discovery"

properties:
  device:
    type: phandle
    required: true
    description: |
      Reference to the hermes device node
```

## dts/bindings/gpio/zephyr,gpio-fake.yaml
```yaml
# Copyright 2025, Alexandre Bailon
# SPDX-License-Identifier: Apache-2.0

description: Fake GPIO

compatible: "zephyr,gpio-fake"

include: [gpio-controller.yaml, base.yaml]

properties:
  "#gpio-cells":
    const: 2

gpio-cells:
  - pin
  - flags
```

## dts/bindings/hermes/device.yaml
```yaml
compatible: pandora,device
description: |
  Configure a Hermes device.
properties:
  device-id:
    type: string
    required: true
    description: |
      Unique identifier for this device

  manufacturer:
    type: string
    description: |
      Device manufacturer name

  firmware-version:
    type: string
    description: |
      Firmware version string


  hardware-version:
    type: string
    description: |
      Hardware version string

  heartbeat-interval:
    type: int
    default: 0
    description: |
      Heartbeat interval in seconds (0 = no heartbeat)
```

## dts/bindings/hermes/light-gpio.yaml
```yaml
description: GPIO light

compatible: "pandora,light-gpio"

properties:
  device_type:
    type: string
    enum:
      - "light"
    default: "light"
  capabilities:
    type: string-array
    enum:
      - "on_off"
      - "dimming"
    default:
      - "on_off"
  gpios:
    type: phandle-array
    required: true
```

## dts/bindings/misc/esphome/nabucasa,esphome-api.yaml
```yaml
# A YAML binding matching the node

compatible: "nabucasa,esphome-api"
description: "Enable support of esphome"

include: [base.yaml]

properties:
    "#address-cells":
      type: int
      required: false
      default: 1
      const: 1
    "#size-cells":
      type: int
      required: false
      default: 0
      const: 0
    password:
      type: string
      required: true
      description: password required to connect to device.
    port:
      type: int
      required: false
      default: 6053
      description: The port to run the API Server on.
```

## dts/bindings/misc/esphome/nabucasa,esphome-button-template.yaml
```yaml
# A YAML binding matching the node

compatible: "nabucasa,esphome-button-template"
description: "Enable support of esphome button"

include: [base.yaml, "nabucasa,esphome-entity.yaml"]

properties:
    on_press:
      type: string
      required: true
      description: |
        Set the name of the function to call on push event
        comming from homeassistant.
```

## dts/bindings/misc/esphome/nabucasa,esphome-entity.yaml
```yaml
# Copyright (c) 2024 Alexandre Bailon
# SPDX-License-Identifier: Apache-2.0

description: |
  This file describes the base properties for an ESPHOME entity.

properties:
    device_name:
      type: string
      required: true
    object_id:
      type: string
      required: false
    icon:
      type: string
      required: false
    disabled_by_default:
      type: boolean
      required: false
```

## dts/bindings/misc/esphome/nabucasa,esphome-logger.yaml
```yaml
compatible: nabucasa,esphome-logger
description: |
  Bindings for logger ESPHome component
properties:
  level:
    type: string
    required: false
    default: DEBUG
  on_message:
    type: string
    required: false
```

## dts/bindings/misc/esphome/nabucasa,esphome-manual-ip.yaml
```yaml
# A YAML binding matching the node

compatible: "nabucasa,esphome-manual-ip"
description: "Wifi component"

include: [base.yaml]

properties:
  static_ip:
    type: string
    description: Static IP of device
  gateway:
    type: string
    description: Gateway of local network
  subnet:
    type: string
    description: Subnet of local network
  dns1:
    type: string
    description: Main server DNS to use
  dns2:
    type: string
    description: Second server DNS to use
```

## dts/bindings/misc/esphome/nabucasa,esphome-sensor-humidty.yaml
```yaml
# A YAML binding matching the node

compatible: "nabucasa,esphome-sensor-humidity"
description: "Enable support of esphome humidity sensor"

include: [base.yaml, "nabucasa,esphome-entity.yaml"]

properties:
    sensor:
      type: phandle
      required: true
    device_class:
      type: string
      enum:
        - "humidity"
      default: "humidity"
      required: false
    unit:
      type: string
      enum:
        - "ESPHOME_UNIT_PERCENT"
      default: "ESPHOME_UNIT_PERCENT"
      required: false
    icon:
      default: "mdi:water-percent"
```

## dts/bindings/misc/esphome/nabucasa,esphome-sensor-temperature.yaml
```yaml
# A YAML binding matching the node

compatible: "nabucasa,esphome-sensor-temperature"
description: "Enable support of esphome tenmperature sensor"

include: [base.yaml, "nabucasa,esphome-entity.yaml"]

properties:
    sensor:
      type: phandle
      required: true
    device_class:
      type: string
      enum:
        - "temperature"
      default: "temperature"
      required: false
    unit:
      type: string
      enum:
        - "ESPHOME_UNIT_CELSUIS"
        - "ESPHOME_UNIT_FAHRENHEIT"
      default: "ESPHOME_UNIT_CELSUIS"
      required: false
    icon:
      default: "mdi:thermometer"
```

## dts/bindings/misc/esphome/nabucasa,esphome-sensor-timestamp.yaml
```yaml
# A YAML binding matching the node

compatible: "nabucasa,esphome-sensor-timestamp"
description: "Enable support of esphome timestamp sensor"

include: [base.yaml, "nabucasa,esphome-entity.yaml"]

properties:
    device_class:
      type: string
      enum:
        - "timestamp"
      required: true
```

## dts/bindings/misc/esphome/nabucasa,esphome-switch-gpio.yaml
```yaml
# A YAML binding matching the node

compatible: "nabucasa,esphome-switch-gpio"
description: "Enable support of esphome gpio switch"

include: [base.yaml, "nabucasa,esphome-entity.yaml"]

properties:
    gpios:
      type: phandle-array
      required: true
    restore_mode:
      type: string
      enum:
        - "SWITCH_ALWAYS_OFF"
        - "SWITCH_ALWAYS_ON"
        - "SWITCH_RESTORE_DEFAULT_OFF"
        - "SWITCH_RESTORE_DEFAULT_ON"
        - "SWITCH_RESTORE_INVERTED_DEFAULT_OFF"
        - "SWITCH_RESTORE_INVERTED_DEFAULT_ON"
        - "SWITCH_RESTORE_DISABLED"
      required: false
      default: "SWITCH_ALWAYS_OFF"
```

## dts/bindings/misc/esphome/nabucasa,esphome-switch-hbridge.yaml
```yaml
compatible: nabucasa,esphome-switch-hbridge
description: |
  The hbridge switch platform allows you to drive an h-bridge controlled latching relay.
include: [base.yaml, "nabucasa,esphome-entity.yaml"]

properties:
  id:
    type: string
    required: false
  inverted:
    type: boolean
    required: false
  internal:
    type: boolean
    required: false
  on_turn_on:
    type: string
    required: false
  on_turn_off:
    type: string
    required: false
  on-gpios:
    type: phandle-array
    required: true
  off-gpios:
    type: phandle-array
    required: true
  pulse_length:
    type: int
    required: false
  wait_time:
    type: int
    required: false
```

## dts/bindings/misc/esphome/nabucasa,esphome-wifi.yaml
```yaml
# A YAML binding matching the node

compatible: "nabucasa,esphome-wifi"
description: "Wifi component"

include: [base.yaml]

properties:
  reboot_timeout:
    type: int
    description: The amount of time (in seconds) to wait before rebooting when no WiFi connection exists.
    default: 900
  on_connect:
    type: string
    description: |
      Set the name of the function to call on connect event.
  on_disconnect:
    type: string
    description: |
      Set the name of the function to call on disconnect event.
  on_error:
    type: string
    description: |
      Set the name of the function to call on error event.
```

## dts/bindings/misc/esphome/nabucasa,esphome.yaml
```yaml
# A YAML binding matching the node

compatible: "nabucasa,esphome"
description: "Enable support of esphome"

include: [base.yaml]

properties:
    "#address-cells":
      type: int
      required: false
      default: 1
      const: 1
    "#size-cells":
      type: int
      required: false
      default: 0
      const: 0
    entity_id:
      type: string
      required: true
      description: Home assistant entity id to use for this device.
    friendly_name:
      type: string
      required: false
      description: Friendly name for this device.
    password:
      type: string
      required: true
      description: password required to connect to device.
    area:
      type: string
      required: false
      default: unknown
      description: The area where the device is located.
    port:
      type: int
      required: false
      default: 6053
      description: The port to run the API Server on.
```

## dts/bindings/misc/esphome/nabucasa,wifi-credentials.yaml
```yaml
# A YAML binding matching the node

compatible: "nabucasa,wifi-credentials"
description: "Wifi credentials DTS backend"

include: [base.yaml]

child-binding:
  properties:
    reg:
      type: int
    ssid:
      type: string
      description: wifi SSID of wifi access point to connect to
      required: true
    password:
      type: string
      description: wifi password
      required: true
    security:
      type: string
      description: wifi security type
      enum:
        - "none"
        - "psk"
        - "wep"
        - "wpa-psk"
        - "wpa-auto-personal"
      default: "psk"
    timeout:
      type: int
      description: Timeout for connecting to the network
      default: 0
```

## dts/bindings/pandora/light-rgbct.yaml
```yaml
description: RGBCT light

compatible: "pandora,light-rgbct"

properties:
  device_type:
    type: string
    enum:
      - "light"
    default: "light"
  capabilities:
    type: string-array
    enum:
      - "on_off"
      - "dimming"
      - "color_control"
    default:
      - "on_off"
  pwms:
    type: phandle-array
  pwm-names:
    type: string-array
```

## dts/bindings/sensor/zephyr,sensor-simulator.yaml
```yaml
description: Sensor Simulator Binding

compatible: "zephyr,sensor-simulator"

include: base.yaml

properties:
  label:
    required: false
    type: string
    description: Human readable string describing the device
    
  default-temperature:
    type: int
    required: false
    default: 25
    description: |
      Default temperature value in degrees Celsius
      
  default-temperature-frac:
    type: int
    required: false
    default: 0
    description: |
      Fractional part of default temperature in 1/100th of degrees Celsius
      
  default-humidity:
    type: int
    required: false
    default: 50
    description: |
      Default humidity value in percentage
      
  default-humidity-frac:
    type: int
    required: false
    default: 0
    description: |
      Fractional part of default humidity in 1/100th of percentage
      
  temp-noise-amplitude:
    type: int
    required: false
    default: 0
    description: |
      Amplitude of noise to add to temperature readings in 1/100th of degrees Celsius
      
  temp-noise-frequency:
    type: int
    required: false
    default: 0
    description: |
      Frequency parameter for temperature noise pattern (0-100)
      
  humidity-noise-amplitude:
    type: int
    required: false
    default: 0
    description: |
      Amplitude of noise to add to humidity readings in 1/100th of percentage
      
  humidity-noise-frequency:
    type: int
    required: false
    default: 0
    description: |
      Frequency parameter for humidity noise pattern (0-100)
```

## modules/protobuf-c/Kconfig
```kconfig
# Copyright (c) 2021 Basalte bv
# SPDX-License-Identifier: Apache-2.0

config ZEPHYR_PROTOBUF_C_MODULE
	bool

menuconfig PROTOBUF_C
	bool "protobuf-c Support"
	help
	  This option enables the protobuf-c library.
```

## samples/narada/narada_light/build/Kconfig/arch/Kconfig
```kconfig
# Load Zephyr Arch Kconfig descriptions.
osource "/home/alex/workspace/gordios/pandora_workspace/zephyr/arch/rx/Kconfig"
osource "/home/alex/workspace/gordios/pandora_workspace/zephyr/arch/x86/Kconfig"
osource "/home/alex/workspace/gordios/pandora_workspace/zephyr/arch/xtensa/Kconfig"
osource "/home/alex/workspace/gordios/pandora_workspace/zephyr/arch/sparc/Kconfig"
osource "/home/alex/workspace/gordios/pandora_workspace/zephyr/arch/riscv/Kconfig"
osource "/home/alex/workspace/gordios/pandora_workspace/zephyr/arch/posix/Kconfig"
osource "/home/alex/workspace/gordios/pandora_workspace/zephyr/arch/mips/Kconfig"
osource "/home/alex/workspace/gordios/pandora_workspace/zephyr/arch/arm64/Kconfig"
osource "/home/alex/workspace/gordios/pandora_workspace/zephyr/arch/arm/Kconfig"
osource "/home/alex/workspace/gordios/pandora_workspace/zephyr/arch/arc/Kconfig"
```
