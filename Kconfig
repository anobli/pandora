## Kconfig
```kconfig
# Copyright (c) 2025 Alexandre Bailon
# SPDX-License-Identifier: Apache-2.0
#

rsource "drivers/Kconfig"
rsource "subsys/net/lib/pandora/Kconfig"
rsource "subsys/net/lib/hermes/Kconfig"
rsource "subsys/net/lib/esphome/Kconfig"
```

## dts/bindings/misc/esphome/pandora,factory-reset.yaml
```yaml
compatible: pandora,factory-reset
description: |
  This enables and configure the factory reset component.
  It could be used to erase network credentials and any other settings
  to restore the device to it initial state.
properties:
  input-code:
    type: int
    description: |
      The input code to wait to trigger a factory reset.
      Basically, this is made to work with the longpress input driver.
      This lets the driver deal with the button and here we just use
      the result to figure out if we need to do a factory reset.
    required: true
```

## dts/bindings/pandora/pandora,binary-sensor-gpio.yaml
```yaml
compatible: "pandora,binary-sensor-gpio"
description: "Enable support of pandora GPIO binary sensor component"

include: ["pandora,component.yaml"]

properties:
  gpios:
    type: phandle-array
    required: true
  debounce-interval-ms:
    type: int
    default: 30
    description: |
       Debouncing interval time in milliseconds.
       If not specified defaults to 30.
```

## dts/bindings/pandora/pandora,component.yaml
```yaml
properties:
    component-name:
      type: string
      description: |
        Human readable string describing the component.
```

## dts/bindings/pandora/pandora,pipeline.yaml
```yaml
compatible: pandora,pipeline
description: |
  This provides a way to configure pipelines.
  The piplelines makes possible acting on output based on input.
  The pipelines could be chained.
properties:
  component-name:
    type: string
    required: true
    description: |
      This defines the name as it will appear in HomeAssistant.
  binary-sensor-on-state:
    type: phandles
  binary-sensor-on-turn-on:
    type: phandles
  binary-sensor-on-turn-off:
    type: phandles
  switch-toggle:
    type: phandles
```

## dts/bindings/pandora/pandora,switch-gpio.yaml
```yaml
compatible: "pandora,switch-gpio"
description: "Enable support of pandora gpio switch component"

include: ["pandora,component.yaml"]

properties:
    gpios:
      type: phandle-array
      required: true
    restore_mode:
      type: string
      enum:
        - "SWITCH_ALWAYS_OFF"
        - "SWITCH_ALWAYS_ON"
        - "SWITCH_RESTORE_DEFAULT_OFF"
        - "SWITCH_RESTORE_DEFAULT_ON"
        - "SWITCH_RESTORE_INVERTED_DEFAULT_OFF"
        - "SWITCH_RESTORE_INVERTED_DEFAULT_ON"
        - "SWITCH_RESTORE_DISABLED"
      default: "SWITCH_ALWAYS_OFF"
```

## dts/bindings/pandora/pandora,switch-hbridge.yaml
```yaml
compatible: pandora,switch-hbridge
description: |
  The hbridge switch platform allows you to drive an h-bridge controlled latching relay.
include: ["pandora,component.yaml"]

properties:
  on-gpios:
    type: phandle-array
    required: true
  off-gpios:
    type: phandle-array
    required: true
  wait-time:
    type: int
    required: false
```

## subsys/net/lib/esphome/components/Kconfig
```kconfig
config ESPHOME_COMPONENT_LOGGER
    bool "ESPHome logger component"
    default y
    depends on DT_HAS_NABUCASA_ESPHOME_LOGGER_ENABLED

config ESPHOME_COMPONENT_API
	bool "ESPHome API"
	default y
	depends on DT_HAS_NABUCASA_ESPHOME_API_ENABLED

if ESPHOME_COMPONENT_API
config ESPHOME_COMPONENT_SWITCH
	bool "ESPHome switch support"
	depends on PANDORA_COMPONENT_SWITCH
	default y
endif

config ESPHOME_COMPONENT_SENSOR
	bool

config ESPHOME_COMPONENT_SENSOR_TEMPERATURE
	bool "Enable support of temperature sensors"
	default y
	depends on DT_HAS_NABUCASA_ESPHOME_SENSOR_TEMPERATURE_ENABLED
    select ESPHOME_COMPONENT_SENSOR

config ESPHOME_COMPONENT_SENSOR_HUMIDITY
	bool "Enable support of humidity sensors"
	default y
	depends on DT_HAS_NABUCASA_ESPHOME_SENSOR_HUMIDITY_ENABLED
    select ESPHOME_COMPONENT_SENSOR

config ESPHOME_COMPONENT_SENSOR_TIMESTAMP
	bool "Enable support of timestamp sensors"
	default y
	depends on DT_HAS_NABUCASA_ESPHOME_SENSOR_TIMESTAMP_ENABLED
    select ESPHOME_COMPONENT_SENSOR

config ESPHOME_COMPONENT_BUTTON
	bool

config ESPHOME_COMPONENT_BUTTON_TEMPLATE
	bool "Enable support of template button"
	default y
	depends on DT_HAS_NABUCASA_ESPHOME_BUTTON_TEMPLATE_ENABLED
    select ESPHOME_COMPONENT_BUTTON
```

## subsys/net/lib/pandora/Kconfig
```kconfig
# Copyright (c) 2025 Alexandre Bailon
# SPDX-License-Identifier: Apache-2.0
#

config PANDORA_SERVICE
	bool "Pandora service"
	default y if SMF
	depends on SMF && EVENTS
	help
	  Provide a service that manage the different events
	  that could affect Hermes state such network disconnection.

config PANDORA_FACTORY_RESET
	bool "Factory reset component"
	default y
	depends on DT_HAS_PANDORA_FACTORY_RESET_ENABLED && REBOOT && INPUT

module = PANDORA
module-str = Pandora
source "subsys/logging/Kconfig.template.log_config"
```

## subsys/net/lib/pandora/components/Kconfig
```kconfig
config PANDORA_COMPONENT_INIT_PRIORITY
        int "Pandora component init priority"
        default 50

rsource "switch/Kconfig"
```

## subsys/net/lib/pandora/components/binary_sensor/Kconfig
```kconfig
config PANDORA_COMPONENT_BINARY_SENSOR
	bool

config PANDORA_COMPONENT_BINARY_SENSOR_GPIO
	bool "GPIO binary sensor"
	select PANDORA_COMPONENT_BINARY_SENSOR
	depends on DT_HAS_PANDORA_BINARY_SENSOR_GPIO_ENABLED
	default y
```

## subsys/net/lib/pandora/components/pipeline/Kconfig
```kconfig
config PANDORA_COMPONENT_PIPELINE
	bool "Pipeline component"
	depends on DT_HAS_PANDORA_PIPELINE_ENABLED
	default y
	help
	  Pipeline component provide a way to link one or more components.
	  This allows a components to trigger an action on another components.
```

## subsys/net/lib/pandora/components/switch/Kconfig
```kconfig
config PANDORA_COMPONENT_SWITCH
	bool

config PANDORA_COMPONENT_SWITCH_HBRIDGE
	bool "H-bridge support"
	depends on DT_HAS_PANDORA_SWITCH_HBRIDGE_ENABLED
	default y
	select PANDORA_COMPONENT_SWITCH

config PANDORA_COMPONENT_SWITCH_GPIO
	bool "Enable support of GPIO switch"
	default y
	depends on DT_HAS_PANDORA_SWITCH_GPIO_ENABLED
	select PANDORA_COMPONENT_SWITCH
```

## tests/net/lib/esphome/components/ota/testcase.yaml
```yaml
tests:
  esphome.component.ota.pytest:
    tags: esphome net
    harness: pytest
    harness_config:
      pytest_dut_scope: session
    platform_allow:
      - qemu_x86
      - native_sim
    integration_platforms:
      - qemu_x86
  esphome.component.ota.unittest:
    tags: esphome net
    platform_allow:
      - qemu_x86
      - native_sim
    integration_platforms:
      - qemu_x86
    extra_configs:
      - CONFIG_ZTEST=y
    expect_reboot: true
```

## tests/net/lib/pandora/components/binary_sensor/gpio/testcase.yaml
```yaml
tests:
  pandora.component.binary_sensor.gpio:
    build_only: false
    platform_allow: native_sim
```

## tests/net/lib/pandora/hbridge/testcase.yaml
```yaml
tests:
  pandora.component.hbridge:
    build_only: false
    platform_allow: native_sim
```
