## CMakeLists.txt
```
# SPDX-License-Identifier: Apache-2.0

cmake_minimum_required(VERSION 3.20.0)
find_package(Zephyr REQUIRED HINTS $ENV{ZEPHYR_BASE})
project(esphome_component_switch_gpio)

target_sources(app PRIVATE src/main.c)
target_include_directories(app PRIVATE
        ${ZEPHYR_ZEPHYR_ESPHOME_MODULE_DIR}/subsys/net/lib/esphome/include
)
```

## prj.conf
```kconfig
#Testing
CONFIG_TEST=y
CONFIG_ZTEST=y

CONFIG_LOG=y
CONFIG_PRINTK=y

CONFIG_GPIO=y
CONFIG_GPIO_EMUL=y
CONFIG_PROTOBUF_C=y
CONFIG_ESPHOME=y
CONFIG_ESPHOME_COMPONENT_SWITCH_GPIO=y

CONFIG_KERNEL_MEM_POOL=y
CONFIG_HEAP_MEM_POOL_SIZE=4096
```

## boards/native_sim.overlay
```dts
#include <zephyr/dt-bindings/gpio/gpio.h>

/ {
	esphome: esphome {
		compatible = "nabucasa,esphome";
		entity_id = "zephyr_esphome";
		friendly_name = " Zephyr ESPHOME sample device";
		password = "mypassword";
		status = "okay";
	};

	gpio_switch {
		compatible = "nabucasa,esphome-switch-gpio";
		device_name = "Bistablerelay";
		gpios = <&gpio0 0 GPIO_ACTIVE_HIGH>;
		status = "okay";
	};

//	api {
//		compatible = "nabucasa,esphome-api";
//		entity_id = "zephyr_esphome";
//		friendly_name = " Zephyr ESPHOME sample device";
//		password = "mypassword";
//		status = "okay";
//	};
};
```

## src/main.c
```c
/*
 * Copyright (c) 2024 Alexandre Bailon
 *
 * SPDX-License-Identifier: Apache-2.0
 */

#include <zephyr/ztest.h>
#include <zephyr/device.h>
#include <zephyr/drivers/gpio.h>
#include <zephyr/drivers/gpio/gpio_emul.h>

#include <esphome/esphome.h>
#include <esphome/components/switch.h>

struct esphome_switch_gpio_tests_fixture {
	const struct device *dev;
	const struct gpio_dt_spec gpio;
};

static void *switch_gpio_setup(void)
{
	static struct esphome_switch_gpio_tests_fixture fixture = {
		.dev = DEVICE_DT_GET(DT_PATH(gpio_switch)),
		.gpio = GPIO_DT_SPEC_GET(DT_PATH(gpio_switch), gpios),
	};
	return &fixture;
}

ZTEST_SUITE(esphome_switch_gpio_tests, NULL, switch_gpio_setup, NULL, NULL, NULL);

ZTEST_F(esphome_switch_gpio_tests, test_esphome_switch_switch_gpio_set_state_on)
{
	int ret;

	ret = esphome_switch_set_state(fixture->dev, 1);
	zassert_equal(ret, 0);
	zassert_equal(gpio_emul_output_get(fixture->gpio.port, 0), 1);
}

ZTEST_F(esphome_switch_gpio_tests, test_esphome_switch_gpio_set_state_off)
{
	int ret;

	ret = esphome_switch_set_state(fixture->dev, 0);
	zassert_equal(ret, 0);
	zassert_equal(gpio_emul_output_get(fixture->gpio.port, 0), 0);
}

ZTEST_F(esphome_switch_gpio_tests, test_esphome_switch_gpio_get_state)
{
	int state;
	int ret;

	ret = esphome_switch_set_state(fixture->dev, 1);
	zassert_equal(ret, 0);

	ret = esphome_switch_get_state(fixture->dev, &state);
	zassert_equal(ret, 0);
	zassert_equal(state, 1);

	ret = esphome_switch_set_state(fixture->dev, 0);
	zassert_equal(ret, 0);

	ret = esphome_switch_get_state(fixture->dev, &state);
	zassert_equal(ret, 0);
	zassert_equal(state, 0);
}
```
