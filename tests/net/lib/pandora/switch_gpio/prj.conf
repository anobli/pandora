## prj.conf
```kconfig
#Testing
CONFIG_TEST=y
CONFIG_ZTEST=y

CONFIG_LOG=y
CONFIG_PRINTK=y

CONFIG_GPIO=y
CONFIG_GPIO_EMUL=y
CONFIG_PANDORA_COMPONENT_SWITCH_GPIO=y

CONFIG_KERNEL_MEM_POOL=y
CONFIG_HEAP_MEM_POOL_SIZE=4096
```

## boards/native_sim.overlay
```dts
#include <zephyr/dt-bindings/gpio/gpio.h>

/ {
	gpio_switch {
		compatible = "pandora,switch-gpio";
		component-name = "Bistablerelay";
		gpios = <&gpio0 0 GPIO_ACTIVE_HIGH>;
		status = "okay";
	};
};
```

## src/main.c
```c
/*
 * Copyright (c) 2024 Alexandre Bailon
 *
 * SPDX-License-Identifier: Apache-2.0
 */

#include <zephyr/ztest.h>
#include <zephyr/device.h>
#include <zephyr/drivers/gpio.h>
#include <zephyr/drivers/gpio/gpio_emul.h>

#include <pandora/components/switch.h>

struct pandora_switch_gpio_tests_fixture {
	const struct device *dev;
	const struct gpio_dt_spec gpio;
};

static void *switch_gpio_setup(void)
{
	static struct pandora_switch_gpio_tests_fixture fixture = {
		.dev = DEVICE_DT_GET(DT_PATH(gpio_switch)),
		.gpio = GPIO_DT_SPEC_GET(DT_PATH(gpio_switch), gpios),
	};
	return &fixture;
}

ZTEST_SUITE(pandora_switch_gpio_tests, NULL, switch_gpio_setup, NULL, NULL, NULL);

ZTEST_F(pandora_switch_gpio_tests, test_pandora_switch_switch_gpio_set_state_on)
{
	int ret;

	ret = pandora_switch_set_state(fixture->dev, 1);
	zassert_equal(ret, 0);
	zassert_equal(gpio_emul_output_get(fixture->gpio.port, 0), 1);
}

ZTEST_F(pandora_switch_gpio_tests, test_pandora_switch_gpio_set_state_off)
{
	int ret;

	ret = pandora_switch_set_state(fixture->dev, 0);
	zassert_equal(ret, 0);
	zassert_equal(gpio_emul_output_get(fixture->gpio.port, 0), 0);
}

ZTEST_F(pandora_switch_gpio_tests, test_pandora_switch_gpio_get_state)
{
	int state;
	int ret;

	ret = pandora_switch_set_state(fixture->dev, 1);
	zassert_equal(ret, 0);

	ret = pandora_switch_get_state(fixture->dev, &state);
	zassert_equal(ret, 0);
	zassert_equal(state, 1);

	ret = pandora_switch_set_state(fixture->dev, 0);
	zassert_equal(ret, 0);

	ret = pandora_switch_get_state(fixture->dev, &state);
	zassert_equal(ret, 0);
	zassert_equal(state, 0);
}
```
